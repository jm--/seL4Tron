## Kconfig
```kconfig
#
# Copyright 2014, NICTA
#
# This software may be distributed and modified according to the terms of
# the BSD 2-Clause license. Note that NO WARRANTY is provided.
#
#-----------------------------------------------------------------------
#
# Copyright (c) 2014 National ICT Australia and other contributors.
# All rights reserved.
#
# Redistribution and use in source and binary forms, with or without
# modification, are permitted provided that the following conditions
# are met:
#
# 1. Redistributions of source code must retain the above copyright
#    notice, this list of conditions and the following disclaimer.
#
# 2. Redistributions in binary form must reproduce the above copyright
#    notice, this list of conditions and the following disclaimer in the
#    documentation and/or other materials provided with the distribution.
#
# THIS SOFTWARE IS PROVIDED BY THE AUTHOR AND CONTRIBUTORS ``AS IS'' AND
# ANY EXPRESS OR IMPLIED WARRANTIES, INCLUDING, BUT NOT LIMITED TO, THE
# IMPLIED WARRANTIES OF MERCHANTABILITY AND FITNESS FOR A PARTICULAR PURPOSE
# ARE DISCLAIMED.  IN NO EVENT SHALL THE AUTHOR OR CONTRIBUTORS BE LIABLE
# FOR ANY DIRECT, INDIRECT, INCIDENTAL, SPECIAL, EXEMPLARY, OR CONSEQUENTIAL
# DAMAGES (INCLUDING, BUT NOT LIMITED TO, PROCUREMENT OF SUBSTITUTE GOODS
# OR SERVICES; LOSS OF USE, DATA, OR PROFITS; OR BUSINESS INTERRUPTION)
# HOWEVER CAUSED AND ON ANY THEORY OF LIABILITY, WHETHER IN CONTRACT, STRICT
# LIABILITY, OR TORT (INCLUDING NEGLIGENCE OR OTHERWISE) ARISING IN ANY WAY
# OUT OF THE USE OF THIS SOFTWARE, EVEN IF ADVISED OF THE POSSIBILITY OF
# SUCH DAMAGE.
#

# This file defines the Kconfig menu structure.

mainmenu "Project Configuration"

config COMMON_PATH
    string
    option env="COMMON_PATH"

menu "seL4 Kernel"
source "kernel/Kconfig"
endmenu

menu "seL4 Applications"
    source "apps/tron/Kconfig"

endmenu

menu "seL4 Libraries"
    source "libs/libsel4/Kconfig"
    source "libs/libmuslc/Kconfig"
    source "libs/libsel4muslcsys/Kconfig"
    source "libs/libsel4vka/Kconfig"
    source "libs/libsel4vspace/Kconfig"
    source "libs/libsel4allocman/Kconfig"
    source "libs/libcpio/Kconfig"
    source "libs/libelf/Kconfig"
    source "libs/libsel4utils/Kconfig"
    source "libs/libsel4platsupport/Kconfig"
    # source "libs/libsel4test/Kconfig"
    source "libs/libsel4simple/Kconfig"
    # source "libs/libsel4simple-default/Kconfig"
    source "libs/libsel4simple-stable/Kconfig"
    source "libs/libutils/Kconfig"
    source "libs/libplatsupport/Kconfig"
endmenu

menu "Tools"
    source "tools/elfloader/Kconfig"
endmenu

source "$COMMON_PATH/Kconfig"
```
